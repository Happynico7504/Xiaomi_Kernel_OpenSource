## drivers/misc/nicochristmann/kernelmodules/Kconfig
```kconfig
menu "mediatek kernel modules"

config NICOCHRISTMANN_MTKMODS

tristate "Mediatek Kernel Modules"

default m

endmenu
```

## drivers/misc/nicochristmann/usbwifi/Kconfig
```kconfig
source "drivers/misc/nicochristmann/usbwifi/src/Kconfig"

config NICOCHRISTMANN_USBWIFI

tristate "USB WiFi Driver"

default m
```
