## drivers/misc/nicochristmann/Kconfig
```kconfig
menu "Bonus Components by Nico Christmann"

source "drivers/misc/nicochristmann/mtkmods/Kconfig"
source "drivers/misc/nicochristmann/usbwifi/Kconfig"
source "drivers/misc/nicochristmann/fbrefreshtimer/Kconfig"
source "drivers/misc/nicochristmann/vkms_copy/Kconfig"
endmenu
```

## drivers/misc/nicochristmann/fakekms/Kconfig
```kconfig
config NICOCHRISTMANN_FAKEKMS

tristate "Fake KMS driver on top of the first fbdev"

depends on DRM

select FB

select BACKLIGHT_LCD_SUPPORT

select BACKLIGHT_CLASS_DEVICE

select DRM_KMS_HELPER

default m

help
  Exposes a minimal atomic KMS device (one CRTC, plane and connector)
  whose dumb buffers are copied into the first registered framebuffer
  device, followed by a pan_display to make the fbdev driver show the
  frame. Lets KMS-only userspace run on fbdev-only display drivers.
```

## drivers/misc/nicochristmann/fbkms/Kconfig
```kconfig
config NICOCHRISTMANN_FBKMS

tristate "Framebuffer Modesetting Driver"

default n
```

## drivers/misc/nicochristmann/fbrefreshtimer/Kconfig
```kconfig
config NICOCHRISTMANN_FBREFRESHTIMER

tristate "Timer Based Framebuffer Refresh"

default n
```
